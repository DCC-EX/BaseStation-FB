## CommandStation-EX-ESP32/components/jmri_interface/Kconfig.projbuild
```kconfig
menu "JMRI Configuration"
    config JMRI_PORT
        int "JMRI Listener Socket"
        default 2560
endmenu
```

## CommandStation-EX-ESP32/components/wifi_config/Kconfig.projbuild
```kconfig
menu "WiFi Configuration"
    config WIFI_SSID
        string "WiFi SSID"

    config WIFI_PASSWORD
        string "WiFi Password"

    config WIFI_MDNS_SERVICE_NAME
        string "mDNS service name"
        default "CommandStation-EX"

    config WIFI_MDNS_INSTANCE_NAME
        string "mDNS instance name"
        default "ESP32 CommandStation-EX interface"
endmenu
```

## CommandStation-EX-ESP32/src/Kconfig.projbuild
```kconfig
menu "WiThrottle Configuration"
    config WITHROTTLE_PORT
        int "WiThrottle Listener Socket"
        default 44444
endmenu
```
